# file: Lab5_I2C.ioc
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Mcu.Family=STM32F0
Mcu.Name=STM32F072R(8-B)Tx
Mcu.Package=LQFP64
ProjectManager.HeapSize=0x200
ProjectManager.StackSize=0x400
ProjectManager.TargetToolchain=MDK-ARM V5
board=Lab5_I2C

// file: Src/main.c
/**
  ******************************************************************************
  * File Name          : main.c
  * Description        : Main program body
  ******************************************************************************
  *
  * COPYRIGHT(c) 2020 STMicroelectronics
  *
  * Redistribution and use in source and binary forms, with or without modification,
  * are permitted provided that the following conditions are met:
  *   1. Redistributions of source code must retain the above copyright notice,
  *      this list of conditions and the following disclaimer.
  *   2. Redistributions in binary form must reproduce the above copyright notice,
  *      this list of conditions and the following disclaimer in the documentation
  *      and/or other materials provided with the distribution.
  *   3. Neither the name of STMicroelectronics nor the names of its contributors
  *      may be used to endorse or promote products derived from this software
  *      without specific prior written permission.
  *
  * THIS SOFTWARE IS PROVIDED BY THE COPYRIGHT HOLDERS AND CONTRIBUTORS "AS IS"
  * AND ANY EXPRESS OR IMPLIED WARRANTIES, INCLUDING, BUT NOT LIMITED TO, THE
  * IMPLIED WARRANTIES OF MERCHANTABILITY AND FITNESS FOR A PARTICULAR PURPOSE ARE
  * DISCLAIMED. IN NO EVENT SHALL THE COPYRIGHT HOLDER OR CONTRIBUTORS BE LIABLE
  * FOR ANY DIRECT, INDIRECT, INCIDENTAL, SPECIAL, EXEMPLARY, OR CONSEQUENTIAL
  * DAMAGES (INCLUDING, BUT NOT LIMITED TO, PROCUREMENT OF SUBSTITUTE GOODS OR
  * SERVICES; LOSS OF USE, DATA, OR PROFITS; OR BUSINESS INTERRUPTION) HOWEVER
  * CAUSED AND ON ANY THEORY OF LIABILITY, WHETHER IN CONTRACT, STRICT LIABILITY,
  * OR TORT (INCLUDING NEGLIGENCE OR OTHERWISE) ARISING IN ANY WAY OUT OF THE USE
  * OF THIS SOFTWARE, EVEN IF ADVISED OF THE POSSIBILITY OF SUCH DAMAGE.
  *
  ******************************************************************************
  */
#include "main.h"
#include "stm32f0xx_hal.h"

/* USER CODE BEGIN PV */
/* Private variables ---------------------------------------------------------*/

/* USER CODE END PV */

void SystemClock_Config(void);
void Error_Handler(void);

/* USER CODE BEGIN PFP */
/* Private function prototypes -----------------------------------------------*/
//blocking method. opens i2c transaction for 1 byte, returns 1 if success

//blocking method. reads i2c transaction for n bytes
int readI2C(uint8_t slaveAddy, uint8_t regAddy, unsigned int numBytes, uint8_t *returnMsg);
//blocking method that writes to a slave, writes n bytes, first byte in msg (msg[0]) is register address
void writeI2C(uint8_t slaveAddy, uint8_t numBytes, uint8_t *msg);

/* USER CODE END PFP */

int main(void)
{

  /* MCU Configuration----------------------------------------------------------*/

  /* Reset of all peripherals, Initializes the Flash interface and the Systick. */
  HAL_Init();

  /* Configure the system clock */
  SystemClock_Config();

  /* Initialize all configured peripherals */

  /* USER CODE BEGIN 2 */
		//enable clocks
	RCC->AHBENR |= RCC_AHBENR_GPIOCEN; //enable gpioc clk
	RCC->AHBENR |= RCC_AHBENR_GPIOBEN; //enable gpiob clk
	RCC->APB1ENR |= RCC_APB1ENR_I2C2EN; //enable i2c2

	//set up leds on board
	GPIO_InitTypeDef LEDinitStr = {GPIO_PIN_6 | GPIO_PIN_7 | GPIO_PIN_8 | GPIO_PIN_9,
															GPIO_MODE_OUTPUT_PP,
															GPIO_SPEED_FREQ_LOW,
															GPIO_NOPULL};

	HAL_GPIO_Init(GPIOC, &LEDinitStr); //enable gpio LED pins
	// turn off led's
	HAL_GPIO_WritePin(GPIOC, GPIO_PIN_6, GPIO_PIN_RESET); //red
	HAL_GPIO_WritePin(GPIOC, GPIO_PIN_7, GPIO_PIN_RESET); //blue
	HAL_GPIO_WritePin(GPIOC, GPIO_PIN_8, GPIO_PIN_RESET); //orange
	HAL_GPIO_WritePin(GPIOC, GPIO_PIN_9, GPIO_PIN_RESET);	// green

	//enable pins
	GPIO_InitTypeDef initStr = {GPIO_PIN_11 | GPIO_PIN_13,
															GPIO_MODE_AF_OD, //set gpio to alternate function, open drain mode
															GPIO_SPEED_FREQ_LOW,
															GPIO_PULLUP};

	HAL_GPIO_Init(GPIOB, &initStr); //enable gpio PC11/13 pin

	GPIO_InitTypeDef initStr1 = {GPIO_PIN_14,
															GPIO_MODE_OUTPUT_PP, //set gpio to alternate function, open drain mode
															GPIO_SPEED_FREQ_LOW,
															GPIO_NOPULL};

	HAL_GPIO_Init(GPIOB, &initStr1); //enable gpio PB14 pin
	HAL_GPIO_WritePin(GPIOB, GPIO_PIN_14, GPIO_PIN_SET); //set pin HIGH

	GPIO_InitTypeDef initStr2 = {GPIO_PIN_0,
															GPIO_MODE_OUTPUT_PP, //set gpio to alternate function, open drain mode
															GPIO_SPEED_FREQ_LOW,
															GPIO_NOPULL};

	HAL_GPIO_Init(GPIOC, &initStr2); //enable gpio PC0 pin
	HAL_GPIO_WritePin(GPIOC, GPIO_PIN_0, GPIO_PIN_SET); //set pin HIGH

	//enable af1 on PB11 and enable af5 on pb13
	GPIOB->AFR[1] |= (1 << 12) | (1 << 20) | (1 << 22);

	//configure i2c2
	I2C2->TIMINGR |= (1 << 28); //PRESC = 1;
	I2C2->TIMINGR |= (0x13 << 0); //SCLL = 0x13;
	I2C2->TIMINGR |= (0xF << 8); //SCLH = 0xF;
	I2C2->TIMINGR |= (0x2 << 16); //SDADEL = 0x2;
	I2C2->TIMINGR |= (0x4 << 20); //SCLDEL = 0x4;
	I2C2->CR1 |= (1 << 0); //peripheral enabled

	/* Clear the NBYTES and SADD bit fields
	* The NBYTES field begins at bit 16, the SADD at bit 0
	*/
	//I2C2->CR2 &= ~((0x7F << 16) | (0x3FF << 0));
	/* Set NBYTES = 42 and SADD = 0x14
	* Can use hex or decimal values directly as bitmasks.
	* Remember that for 7-bit addresses, the lowest SADD bit
	* is not used and the mask must be shifted by one.
	*/
	//I2C2->CR2 |= (42 << 16) | (0x14 << 1);
  /* USER CODE END 2 */

  /* Infinite loop */
  /* USER CODE BEGIN WHILE */
	const uint8_t gyroAddress = 0x6B;
	const uint8_t gyroWhoAmI = 0x0F; //lab5.pdf pg 10
	const uint8_t expectedVal = 0xD4;
	const uint8_t ctrlReg = 0x20;
	const uint8_t ctrlCmd = 0xB; //0b001011
	const uint8_t accelReg = 0xA8;

	int16_t accX = NULL;
	int16_t accY = NULL;
	uint8_t returnMsg[4];

	//init gyro
	uint8_t ctrlArr[] = {ctrlReg, ctrlCmd};
	writeI2C(gyroAddress, 2, ctrlArr);

	const int thres = 10000;

  while (1)
  {
		readI2C(gyroAddress, accelReg, 4, returnMsg);

		//concatenate
		accX = (returnMsg[1] << 8) | (returnMsg[0]);
		accY = (returnMsg[3] << 8) | (returnMsg[2]);

		if(accX >= thres){
			HAL_GPIO_WritePin(GPIOC, GPIO_PIN_9, GPIO_PIN_SET);
			HAL_GPIO_WritePin(GPIOC, GPIO_PIN_8, GPIO_PIN_RESET);
		}
		else if(accX <= -thres){
			HAL_GPIO_WritePin(GPIOC, GPIO_PIN_9, GPIO_PIN_RESET);
			HAL_GPIO_WritePin(GPIOC, GPIO_PIN_8, GPIO_PIN_SET);
		}

		if(accY >= thres){
			HAL_GPIO_WritePin(GPIOC, GPIO_PIN_6, GPIO_PIN_SET);
			HAL_GPIO_WritePin(GPIOC, GPIO_PIN_7, GPIO_PIN_RESET);
		}
		else if(accY <= -thres){
			HAL_GPIO_WritePin(GPIOC, GPIO_PIN_6, GPIO_PIN_RESET);
			HAL_GPIO_WritePin(GPIOC, GPIO_PIN_7, GPIO_PIN_SET);
		}

		HAL_Delay(100);

  }

}

void writeI2C(uint8_t slaveAddy, uint8_t numBytes, uint8_t *msg){
	//configure transaction params
	I2C2->CR2 = 0; //clear CR2 register
	I2C2->CR2 |= (slaveAddy << 1); //set SADD (slave address)
	I2C2->CR2 &= ~(1 << 10); //set write direction
	I2C2->CR2 |= (numBytes << 16); //set  byte to transfer
	I2C2->CR2 |= (1 << 13); //set start bit, periprefman.pdf pg 675

	for(int i = 0; i < numBytes; ++i){
		//wait unitl TXIS flags are set, periphrefman.pdf pg. 680
		while(!(I2C2->ISR & (1 << 1))){
			if(I2C2->ISR & (1 << 4)){ //if NACKF set
				HAL_GPIO_WritePin(GPIOC, GPIO_PIN_6, GPIO_PIN_SET);	//throw err
			}
		}

		//send slave msg
		I2C2->TXDR = msg[i];
	}

	//wait till transfer complete flag is set
	while(!(I2C2->ISR & (1 << 6))){
		//do nothing
	}
}

int readI2C(uint8_t slaveAddy, uint8_t regAddy, unsigned int numBytes, uint8_t *returnMsg){
	////////////////write slave address ////////////////////////////
	writeI2C(slaveAddy, 1, &regAddy);

	//configure transaction params
	I2C2->CR2 = 0; //clear entire register NBYTES and SADD
	I2C2->CR2 |= (slaveAddy << 1); //set SADD (slave address)
	I2C2->CR2 |= (1 << 10); //set read direction
	I2C2->CR2 |= (numBytes << 16); //set bytes to transfer
	I2C2->CR2 |= (1 << 13); //set start bit, periprefman.pdf pg 675

	//////////////////read slave msg////////////////////////////
	for(int i = 0; i < numBytes; ++i){
		//wait unitl RXNE flags are set, periphrefman.pdf pg. 680
		while(!(I2C2->ISR & ((1 << 2) | (1 << 4)))){
			if(I2C2->ISR & (1<<4)){ //if NACKF set
				HAL_GPIO_WritePin(GPIOC, GPIO_PIN_6, GPIO_PIN_SET);	//throw err
				return NULL;	//throw err
			}
		}

		returnMsg[i] = I2C2->RXDR;
	}

	//wait till transfer complete flag is set
	while(!(I2C2->ISR & (1 << 6))){
		//do nothing
	}
	I2C2->CR2 |= (1 << 14); //set stop bit
}

/** System Clock Configuration
*/
void SystemClock_Config(void)
{

  RCC_OscInitTypeDef RCC_OscInitStruct;
  RCC_ClkInitTypeDef RCC_ClkInitStruct;

    /**Initializes the CPU, AHB and APB busses clocks
    */
  RCC_OscInitStruct.OscillatorType = RCC_OSCILLATORTYPE_HSI;
  RCC_OscInitStruct.HSIState = RCC_HSI_ON;
  RCC_OscInitStruct.HSICalibrationValue = 16;
  RCC_OscInitStruct.PLL.PLLState = RCC_PLL_NONE;
  if (HAL_RCC_OscConfig(&RCC_OscInitStruct) != HAL_OK)
  {
    Error_Handler();
  }

    /**Initializes the CPU, AHB and APB busses clocks
    */
  RCC_ClkInitStruct.ClockType = RCC_CLOCKTYPE_HCLK|RCC_CLOCKTYPE_SYSCLK
                              |RCC_CLOCKTYPE_PCLK1;
  RCC_ClkInitStruct.SYSCLKSource = RCC_SYSCLKSOURCE_HSI;
  RCC_ClkInitStruct.AHBCLKDivider = RCC_SYSCLK_DIV1;
  RCC_ClkInitStruct.APB1CLKDivider = RCC_HCLK_DIV1;

  if (HAL_RCC_ClockConfig(&RCC_ClkInitStruct, FLASH_LATENCY_0) != HAL_OK)
  {
    Error_Handler();
  }

    /**Configure the Systick interrupt time
    */
  HAL_SYSTICK_Config(HAL_RCC_GetHCLKFreq()/1000);

    /**Configure the Systick
    */
  HAL_SYSTICK_CLKSourceConfig(SYSTICK_CLKSOURCE_HCLK);

  /* SysTick_IRQn interrupt configuration */
  HAL_NVIC_SetPriority(SysTick_IRQn, 0, 0);
}

void Error_Handler(void)
{
  while(1)
  {
  }
}

/************************ (C) COPYRIGHT STMicroelectronics *****END OF FILE****/
